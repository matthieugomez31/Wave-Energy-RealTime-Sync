/*
 * =======================================================
 * CODE FOR WIRELESS DAQ: "Wireless Master Logger"
 * =======================================================
 * Architecture: ESP32 as Wi-Fi Access Point (AP) + UDP Broadcaster
 * - Reads INA219 sensor (Electrical data).
 * - Broadcasts UDP packets to the network.
 * - DOES NOT act as Time Master anymore (PC handles time).
 */

#include <WiFi.h>
#include <WiFiUdp.h>
#include <Wire.h>
#include <Adafruit_INA219.h>

// --- Configuration ---
const char* ssid = "WEC_Buoy";         // Name of the Wi-Fi network generated by ESP32
const char* password = "berkeleywec";  // Password (must be at least 8 characters)
const int udpPort = 4210;              // Port for UDP communication

// The default IP of an ESP32 Access Point is 192.168.4.1.
// To broadcast to all connected devices, we send to 192.168.4.255.
const char* broadcastIP = "192.168.4.255"; 

Adafruit_INA219 ina219;
WiFiUDP udp;

const int SAMPLING_RATE_MS = 20; // 50Hz transmission rate
unsigned long lastSampleTime = 0;

void setup() {
  Serial.begin(115200);
  delay(1000);

  Serial.println("\n--- WEC Wireless Buoy Initialization ---");

  // 1. Initialize INA219 Sensor
  if (!ina219.begin()) {
    Serial.println("[ERROR] Failed to find INA219. Check wiring.");
    // Blink LED or halt here if needed
  } else {
    Serial.println("[OK] INA219 sensor found.");
  }

  // 2. Initialize Wi-Fi Access Point
  Serial.print("Setting up Wi-Fi Access Point... ");
  WiFi.softAP(ssid, password);
  Serial.println("[OK]");
  
  IPAddress IP = WiFi.softAPIP();
  Serial.print("AP IP address: ");
  Serial.println(IP);

  // 3. Initialize UDP
  udp.begin(udpPort);
  Serial.println("[OK] UDP Broadcaster ready.");

  lastSampleTime = millis();
}

void loop() {
  // --- Time Loop ---
  if (millis() - lastSampleTime >= SAMPLING_RATE_MS) {
    lastSampleTime = millis();
    
    // 1. Read Local Sensors (Electrical)
    float busVoltage = ina219.getBusVoltage_V();
    float current_mA = ina219.getCurrent_mA();
    
    // Prevent small negative noise values
    if (busVoltage < 0) busVoltage = 0.0;
    if (current_mA < 0) current_mA = 0.0;

    // 2. Format Data Packet (Comma separated)
    // Example: "3.25,150.50"
    String packet = String(busVoltage, 2) + "," + String(current_mA, 2);
    
    // 3. Send UDP Packet (Broadcast to the PC)
    udp.beginPacket(broadcastIP, udpPort);
    udp.print(packet);
    udp.endPacket();

    // Debugging (Optional, can be removed to save processing time)
    // Serial.println("TX: " + packet);
  }
}